## yocto/meta-mys-dac/conf/layer.conf
```bitbake
# We have a conf and classes directory, add to BBPATH
BBPATH .= ":${LAYERDIR}"

# We have recipes-* directories, add to BBFILES
BBFILES += "${LAYERDIR}/recipes-*/*/*.bb \
            ${LAYERDIR}/recipes-*/*/*.bbappend"

BBFILE_COLLECTIONS += "meta-mys-dac"
BBFILE_PATTERN_meta-mys-dac = "^${LAYERDIR}/"
BBFILE_PRIORITY_meta-mys-dac = "6"

LAYERDEPENDS_meta-mys-dac = "core"
LAYERSERIES_COMPAT_meta-mys-dac = "zeus"
```

## yocto/meta-mys-dac/conf/machine/mys-dac.conf
```bitbake
#@TYPE: Machine
#@NAME: MYiR MYS-6ULX based DAC machine
#@DESCRIPTION: Machine configuration for Sven Schwermer's MYiR MYS-6ULX based DAC

MACHINEOVERRIDES =. "imx:mx6:mx6ull:"
DEFAULTTUNE ?= "cortexa7thf-neon"

include conf/machine/include/imx-base.inc
require conf/machine/include/tune-cortexa7.inc

PREFERRED_PROVIDER_virtual/kernel = "linux-yocto"
PREFERRED_PROVIDER_u-boot = "u-boot-mys"
PREFERRED_PROVIDER_virtual/bootloader = "${PREFERRED_PROVIDER_u-boot}"

KERNEL_IMAGETYPE = "fitImage"
#KERNEL_ALT_IMAGETYPE = "zImage"
KERNEL_DEVICETREE = "imx6ull-mys-6ulx-iot.dtb"
KERNEL_CLASSES += "kernel-fitimage"

UBOOT_ARCH = "arm"
UBOOT_MACHINE = "mys_6ulx_iot_defconfig"
UBOOT_ENTRYPOINT_mys-dac = "0x82000000"
UBOOT_LOADADDRESS = "0x82000000"
SPL_BINARY = "SPL"
UBOOT_SUFFIX = "img"

MACHINE_FEATURES = "usbgadget usbhost vfat ext2 screen alsa ethernet wifi"
MACHINE_GUI_CLASS = "smallscreen"
#MACHINE_ESSENTIAL_EXTRA_RDEPENDS = "u-boot"
MACHINE_ESSENTIAL_EXTRA_RRECOMMENDS = "kernel-modules linux-firmware-imx-sdma-imx6q"

SERIAL_CONSOLES = "115200;ttymxc0"

#EXTRA_IMAGEDEPENDS += "virtual/bootloader"
IMAGE_FSTYPES = "tar.xz ubi"
#IMAGE_BOOT_FILES ?= "u-boot.${UBOOT_SUFFIX}"
UBI_VOLNAME = "rootfs"
MKUBIFS_ARGS = "-m 2048 -e 124KiB -c 2048"
UBINIZE_ARGS = "-p 128KiB -m 2048 -s 2048"
```
